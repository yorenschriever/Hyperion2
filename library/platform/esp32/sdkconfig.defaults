## library/platform/esp32/sdkconfig.defaults
```kconfig
# CPU FRQ
CONFIG_ESP_DEFAULT_CPU_FREQ_MHZ_240=y
# set -O2 optimization level
CONFIG_COMPILER_OPTIMIZATION_PERF=y

# ESP32-POE Ethernet
CONFIG_ETH_RMII_CLK_OUTPUT=y
CONFIG_ETH_SPI_ETHERNET_W5500=y
CONFIG_ESP_HTTP_CLIENT_ENABLE_DIGEST_AUTH=y
CONFIG_ESP_SLEEP_POWER_DOWN_FLASH=y
CONFIG_ESP_IPC_TASK_STACK_SIZE=1536

# LWIP
CONFIG_LWIP_MAX_SOCKETS=16
CONFIG_LWIP_IP4_REASSEMBLY=y
CONFIG_LWIP_IP6_REASSEMBLY=y
CONFIG_LWIP_IP4_FRAG=y
CONFIG_LWIP_IP6_FRAG=y
CONFIG_LWIP_IRAM_OPTIMIZATION=y
CONFIG_LWIP_DNS_SUPPORT_MDNS_QUERIES=y
CONFIG_LWIP_AUTOIP=y

CONFIG_ESPTOOLPY_FLASHMODE_QIO=y
CONFIG_ESPTOOLPY_FLASHFREQ_80M=y
CONFIG_ESPTOOLPY_FLASHSIZE_4MB=y

# RMT
CONFIG_RMT_ISR_IRAM_SAFE=y

# Watchdog
# CONFIG_ESP_TASK_WDT_INIT is not set

# Partition table
CONFIG_PARTITION_TABLE_CUSTOM=y
CONFIG_PARTITION_TABLE_CUSTOM_FILENAME="$ENV{HYPERION_LIB_DIR}/platform/esp32/partitions.csv"
CONFIG_PARTITION_TABLE_FILENAME="$ENV{HYPERION_LIB_DIR}/platform/esp32/partitions.csv"

# HTTPS
CONFIG_ESP_HTTPS_SERVER_ENABLE=y
CONFIG_HTTPD_MAX_REQ_HDR_LEN=1024

# Websockets
CONFIG_HTTPD_WS_SUPPORT=y

# No need to change this yet
# CONFIG_LWIP_MAX_SOCKETS=10
```

## library/platform/hypernode/sdkconfig.defaults
```kconfig
# CPU FRQ
CONFIG_ESP_DEFAULT_CPU_FREQ_MHZ_240=y
# set -O2 optimization level
CONFIG_COMPILER_OPTIMIZATION_PERF=y

# ESP32-POE Ethernet
CONFIG_ETH_PHY_INTERFACE_RMII=y
CONFIG_ETH_RMII_CLK_OUTPUT=y
CONFIG_ETH_DMA_BUFFER_SIZE=1600
CONFIG_ETH_DMA_RX_BUFFER_NUM=20
CONFIG_ETH_DMA_TX_BUFFER_NUM=20
CONFIG_ESP_HTTP_CLIENT_ENABLE_DIGEST_AUTH=y
CONFIG_ESP_SLEEP_POWER_DOWN_FLASH=y
CONFIG_ESP_IPC_TASK_STACK_SIZE=1536
CONFIG_ETH_USE_ESP32_EMAC=y
CONFIG_ETH_IRAM_OPTIMIZATION=y
CONFIG_ETH_SOFT_FLOW_CONTROL=y

# LWIP
CONFIG_LWIP_LOCAL_HOSTNAME="Hyperion"
CONFIG_LWIP_IRAM_OPTIMIZATION=y
CONFIG_LWIP_MAX_SOCKETS=16
CONFIG_LWIP_SO_RCVBUF=y
CONFIG_LWIP_DHCP_DOES_ARP_CHECK=n
CONFIG_LWIP_DHCP_RESTORE_LAST_IP=y
CONFIG_LWIP_AUTOIP=y
CONFIG_LWIP_TCP_SYNMAXRTX=6
CONFIG_LWIP_TCP_MSS=1436
CONFIG_LWIP_MAX_UDP_PCBS=20
CONFIG_LWIP_UDP_RECVMBOX_SIZE=20
CONFIG_LWIP_TCPIP_TASK_STACK_SIZE=2560
CONFIG_LWIP_TCPIP_TASK_AFFINITY_CPU0=y
CONFIG_LWIP_PPP_SUPPORT=y
CONFIG_LWIP_PPP_PAP_SUPPORT=y
CONFIG_LWIP_PPP_CHAP_SUPPORT=y
CONFIG_LWIP_PPP_MSCHAP_SUPPORT=y
CONFIG_LWIP_PPP_MPPE_SUPPORT=y

CONFIG_LWIP_IP4_REASSEMBLY=y
CONFIG_LWIP_IP6_REASSEMBLY=y
CONFIG_LWIP_IP4_FRAG=y
CONFIG_LWIP_IP6_FRAG=y
CONFIG_LWIP_IRAM_OPTIMIZATION=y
CONFIG_LWIP_DNS_SUPPORT_MDNS_QUERIES=y
CONFIG_LWIP_AUTOIP=y

CONFIG_LWIP_SO_LINGER=y

#Flash memory
CONFIG_ESPTOOLPY_FLASHMODE_QIO=y
CONFIG_ESPTOOLPY_FLASHFREQ_80M=y
CONFIG_ESPTOOLPY_FLASHSIZE_4MB=y

# RMT
CONFIG_RMT_ISR_IRAM_SAFE=y

# Watchdog
# CONFIG_ESP_TASK_WDT_INIT is not set

# Partition table
CONFIG_PARTITION_TABLE_CUSTOM=y
CONFIG_PARTITION_TABLE_CUSTOM_FILENAME="$ENV{HYPERION_LIB_DIR}/platform/esp32/partitions.csv"
CONFIG_PARTITION_TABLE_FILENAME="$ENV{HYPERION_LIB_DIR}/platform/esp32/partitions.csv"

# HTTPS
CONFIG_ESP_HTTPS_SERVER_ENABLE=y
CONFIG_HTTPD_MAX_REQ_HDR_LEN=1024

# Websockets
CONFIG_HTTPD_WS_SUPPORT=y

# MDNS
CONFIG_LWIP_DNS_SUPPORT_MDNS_QUERIES=y

#UART: DMX, MIDI
CONFIG_UART_ISR_IN_IRAM=y

CONFIG_FREERTOS_HZ=1000

#spiffs
CONFIG_SPIFFS_OBJ_NAME_LEN=128
```
